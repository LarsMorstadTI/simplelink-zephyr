/*
 * Copyright (c) 2025 Texas Instruments Incorporated
 *
 * SPDX-License-Identifier: Apache-2.0
 *
 * BoosterPack connector for CC2340R5 MODA LaunchPad.
 * Note: Many pins are NC (not connected) due to module package.
 */

/ {
	boosterpack_header: connector {
		compatible = "ti,boosterpack-header";
		#gpio-cells = <2>;
		gpio-map = <3 0 &gpio0 20 0>,   /* DIO20 - UART RX */
			   <4 0 &gpio0 6 0>,    /* DIO6 - UART TX */
			   <5 0 &gpio0 4 0>,    /* DIO4 */
			   <8 0 &gpio0 3 0>,    /* DIO3 */

			   <12 0 &gpio0 24 0>,  /* DIO24 - BTN2 */
			   <13 0 &gpio0 18 0>,  /* DIO18 - BTN1/SPI CLK */
			   <15 0 &gpio0 12 0>,  /* DIO12 - SPI PICO */

			   <38 0 &gpio0 11 0>,  /* DIO11 - SPI CS */
			   <39 0 &gpio0 21 0>,  /* DIO21 - Red LED/SPI POCI */
			   <40 0 &gpio0 8 0>;   /* DIO8 - Green LED */
	};
};
